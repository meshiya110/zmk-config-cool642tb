## config/west.yml
```yaml
manifest:
remotes:
  - name: cormoran
    url-base: https://github.com/cormoran
  - name: meshiya110
    url-base: https://github.com/meshiya110

  projects:
    - name: zmk
      remote: cormoran
      revision: v0.3-branch+dya
      import: app/west.yml

- name: zmk-module-ble-management
  remote: meshiya110
  revision: main

    - name: zmk-module-battery-history
      remote: cormoran
      revision: main

    - name: zmk-module-settings-rpc
      remote: cormoran
      revision: main

    - name: zmk-module-runtime-input-processor
      remote: cormoran
      revision: change-dependency

    - name: zmk-behavior-runtime-sensor-rotate
      remote: cormoran
      revision: main

    # Optional: PMW3610 driver
    - name: zmk-pmw3610-driver
      remote: badjeff
      revision: zmk-0.3

  self:
    path: config
```
